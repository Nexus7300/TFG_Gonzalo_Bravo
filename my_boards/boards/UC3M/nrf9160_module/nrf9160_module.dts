/dts-v1/;
#include <nordic/nrf9160_sica.dtsi>
#include "nrf9160_module-pinctrl.dtsi"
#include "nrf9160_module-partitioning.dtsi"

/ {
	chosen {
		zephyr,sram = &sram0_s;
		zephyr,flash = &flash0;
		zephyr,code-partition = &slot0_partition;
		zephyr,sram-secure-partition = &sram0_s;
		zephyr,sram-non-secure-partition = &sram0_ns;
	};
};
