## my_boards/boards/UC3M/nrf5340_module/Kconfig.nrf5340_module
```kconfig
config BOARD_NRF5340_MODULE
	select SOC_NRF5340_CPUAPP_QKAA if BOARD_NRF5340_MODULE_NRF5340_CPUAPP
	select SOC_NRF5340_CPUAPP_QKAA if BOARD_NRF5340_MODULE_NRF5340_CPUAPP_NS
	select SOC_NRF5340_CPUNET_QKAA if BOARD_NRF5340_MODULE_NRF5340_CPUNET
```

## my_boards/boards/UC3M/nrf5340_module/board.yml
```yaml
board:
  name: nrf5340_module
  vendor: UC3M
  socs:
  - name: nrf5340
    variants:
    - name: ns
      cpucluster: cpuapp
```

## my_boards/boards/UC3M/nrf9160_module/board.yml
```yaml
board:
  name: nrf9160_module
  vendor: UC3M
  socs:
  - name: nrf9160
    variants:
    - name: ns
```
